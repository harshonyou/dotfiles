## keeb/config/zen-2/config/west.yml
```yaml
manifest:
  remotes:
    - name: zmkfirmware
      url-base: https://github.com/zmkfirmware
    - name: harshonyou
      url-base: https://github.com/harshonyou
  projects:
    - name: zmk
      remote: harshonyou
      revision: caksoylar/zen-v1+v2
      import: app/west.yml
  self:
    path: keeb/config/zen-2
```
